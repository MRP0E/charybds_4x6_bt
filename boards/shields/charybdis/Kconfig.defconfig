## boards/shields/charybdis/Kconfig.defconfig
```kconfig
if SHIELD_CHARYBDIS_LEFT

# Name must be less than 16 characters long!
config ZMK_KEYBOARD_NAME
    default "charybdis"

config ZMK_SPLIT_ROLE_CENTRAL
    default n

config ZMK_SPLIT_BLE_CENTRAL_PERIPHERALS
  default 1

config BT_MAX_CONN
  default 6

config BT_MAX_PAIRED
  default 6

endif

if SHIELD_CHARYBDIS_LEFT || SHIELD_CHARYBDIS_RIGHT

config ZMK_SPLIT
    default y

endif

if SHIELD_CHARYBDIS_DONGLE

# Name must be less than 16 characters long!
config ZMK_KEYBOARD_NAME
    default "charybdis"

config ZMK_SPLIT
    default y

config ZMK_SPLIT_ROLE_CENTRAL
    default y

config ZMK_SPLIT_BLE_CENTRAL_PERIPHERALS
  default 2

config BT_MAX_CONN
  default 7

config BT_MAX_PAIRED
  default 7

config CONFIG_PROSPECTOR_STATUS_SCREEN_OPERATOR
  default y 

endif
```
